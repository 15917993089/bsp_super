/ {
	input_dev_demo {
		compatible = "100ask,input_dev_demo";
		reg = <0x021B4000 16>;//指定了基地址，我们要指定基地址才能访问寄存器
		//interrupt-parent = <&gpio1>;//以前指定中断的信息
		//interrupts = <5 IRQ_TYPE_EDGE_FALLING | IRQ_TYPE_EDGE_RISING>;
		gpios = <&gpio1 5 1>;//现在指定gpio的信息
	};
};
